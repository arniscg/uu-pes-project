## CMakeLists.txt
```
cmake_minimum_required(VERSION 3.20.0)

find_package(Zephyr REQUIRED HINTS $ENV{ZEPHYR_BASE})
project(controller)

FILE(GLOB app_sources src/*.c)
target_sources(app PRIVATE ${app_sources})
```

## prj.conf
```kconfig
CONFIG_BT=y
# CONFIG_BT_DEBUG_LOG=y
CONFIG_BT_SMP=y
CONFIG_BT_PERIPHERAL=y

CONFIG_STDOUT_CONSOLE=y
CONFIG_NEWLIB_LIBC=y
CONFIG_I2C=y
CONFIG_SENSOR=y
CONFIG_VEML7700=y
```

## src/main.c
```c
#include <zephyr/types.h>
#include <stddef.h>
#include <string.h>
#include <errno.h>
#include <sys/printk.h>
#include <sys/byteorder.h>
#include <zephyr.h>
#include <device.h>
#include <drivers/sensor.h>
#include <stdio.h>
#include "bluetooth.h"
#include <devicetree.h>
#include <drivers/gpio.h>

#define BUTTON_DEBOUNCE_DELAY_MS 	100
#define MY_STACK_SIZE 				1000
#define WAIT_LONG 					2000
#define WAIT_SHORT					200

#define SW0_NODE	DT_ALIAS(sw0)
#define SW0			DT_GPIO_LABEL(SW0_NODE, gpios)
#define SW0_PIN		DT_GPIO_PIN(SW0_NODE, gpios)
#define SW0_FLAGS	(GPIO_INPUT | DT_GPIO_FLAGS(SW0_NODE, gpios))

#define SW1_NODE	DT_ALIAS(sw1)
#define SW1			DT_GPIO_LABEL(SW1_NODE, gpios)
#define SW1_PIN		DT_GPIO_PIN(SW1_NODE, gpios)
#define SW1_FLAGS	(GPIO_INPUT | DT_GPIO_FLAGS(SW1_NODE, gpios))

#define SW2_NODE	DT_ALIAS(sw2)
#define SW2			DT_GPIO_LABEL(SW2_NODE, gpios)
#define SW2_PIN		DT_GPIO_PIN(SW2_NODE, gpios)
#define SW2_FLAGS	(GPIO_INPUT | DT_GPIO_FLAGS(SW2_NODE, gpios))

#define SW3_NODE	DT_ALIAS(sw3)
#define SW3			DT_GPIO_LABEL(SW2_NODE, gpios)
#define SW3_PIN		DT_GPIO_PIN(SW3_NODE, gpios)
#define SW3_FLAGS	(GPIO_INPUT | DT_GPIO_FLAGS(SW3_NODE, gpios))

static uint32_t time, last_time;
static struct gpio_callback button_cb_data;
static struct gpio_callback button_cb_data1;
static struct gpio_callback button_cb_data2;
static struct gpio_callback button_cb_data3;

static volatile uint8_t adjustment_mode = 0;

static void handle_adjustment_request(uint8_t data)
{
	if (data == 0)
	{
		printk("Exiting adjustment mode\n");
		adjustment_mode = 0;
	} else if (data == 1)
	{
		printk("Entering adjustment mode\n");
		adjustment_mode = 1;
	} else
	{
		printk("Warning: Got unexpected adjutment request valule '%d'\n", data);
	}
}

void button_pressed(const struct device *dev, struct gpio_callback *cb, uint32_t pins)
{
	time = k_uptime_get_32();
	 //printf("Button pressed\n");
	if (time < last_time + BUTTON_DEBOUNCE_DELAY_MS) 
	{
		last_time = time;
		return;
	}

	time = last_time;

	if(pins == BIT(SW0_PIN))
	{
        send_button_value(0);       
	}
	else if(pins == BIT(SW1_PIN))
	{
		send_button_value(1);  
	}
	else if(pins == BIT(SW2_PIN))
	{
       send_button_value(2); 
	}
	else if(pins == BIT(SW3_PIN))
	{
		send_button_value(3); 
	}
	else
	{
		printf("not valid button pressed");
	}
}

void button_task()
{
     /* Set up button interrupt */
	const struct device *sw0;
	sw0 = device_get_binding(SW0);
	gpio_pin_configure(sw0, SW0_PIN, GPIO_INPUT | SW0_FLAGS);
	gpio_pin_interrupt_configure(sw0, SW0_PIN, GPIO_INT_EDGE_TO_ACTIVE);
	gpio_init_callback(&button_cb_data, button_pressed, BIT(SW0_PIN));
	gpio_add_callback(sw0, &button_cb_data);

	const struct device *sw1;
	sw1 = device_get_binding(SW1);
	gpio_pin_configure(sw1, SW1_PIN, GPIO_INPUT | SW1_FLAGS);
	gpio_pin_interrupt_configure(sw1, SW1_PIN, GPIO_INT_EDGE_TO_ACTIVE);
	gpio_init_callback(&button_cb_data1, button_pressed, BIT(SW1_PIN));
	gpio_add_callback(sw1, &button_cb_data1);

	const struct device *sw2;
	sw2 = device_get_binding(SW2);
	gpio_pin_configure(sw2, SW2_PIN, GPIO_INPUT | SW2_FLAGS);
	gpio_pin_interrupt_configure(sw2, SW2_PIN, GPIO_INT_EDGE_TO_ACTIVE);
	gpio_init_callback(&button_cb_data2, button_pressed, BIT(SW2_PIN));
	gpio_add_callback(sw2, &button_cb_data2);

	const struct device *sw3;
	sw3 = device_get_binding(SW3);
	gpio_pin_configure(sw3, SW3_PIN, GPIO_INPUT | SW3_FLAGS);
	gpio_pin_interrupt_configure(sw3, SW3_PIN, GPIO_INT_EDGE_TO_ACTIVE);
	gpio_init_callback(&button_cb_data3, button_pressed, BIT(SW3_PIN));
	gpio_add_callback(sw3, &button_cb_data3);

	while(1)
	{
		k_sleep(K_SECONDS(3));
	}  
}

void main()
{
    int bt_okay = connect_bluetooth();
	if (!bt_okay) {
		printf("Failed to connect to bluetooth");
		return;
	}

    const struct device *veml7700 = device_get_binding("VEML7700");
	if (veml7700 == NULL) {
		printf("No device \"%s\" found; did initialization fail?\n", "VEML7700");
		return;
	}

    struct sensor_value lux;

	while(1)
	{
		if (connected_to_basestation)
		{
			if (adjustment_mode)
				k_msleep(WAIT_SHORT);
			else
				k_msleep(WAIT_LONG);

			// Get sensor reading
			sensor_sample_fetch(veml7700);
			sensor_channel_get(veml7700, SENSOR_CHAN_LIGHT, &lux);

			// Send to basestation
			send_light_sensor_value(lux.val1);
		} else 
		{
			k_msleep(WAIT_LONG);
		}
	}      
}

K_THREAD_DEFINE(button, MY_STACK_SIZE, button_task, NULL, NULL, NULL, 0, 0, 0);
```

## src/bluetooth.h
```c
#include <bluetooth/bluetooth.h>
#include <bluetooth/hci.h>
#include <bluetooth/conn.h>
#include <bluetooth/uuid.h>
#include <bluetooth/gatt.h>

#include "bluetooth_service.h"

static uint8_t connected_to_basestation = 0;

static const struct bt_data ad[] = {
	BT_DATA_BYTES(BT_DATA_FLAGS, (BT_LE_AD_GENERAL | BT_LE_AD_NO_BREDR)),
	BT_DATA_BYTES(BT_DATA_UUID128_ALL,
		BT_CONTROLLER_SERVICE_UUID_BYTES
	)
};

static void connected(struct bt_conn *conn, uint8_t err)
{
	if (err) {
		printk("Connection failed (err 0x%02x)\n", err);
	} else {
		printk("Connected\n");
	}

	connected_to_basestation = 1;
}

static void disconnected(struct bt_conn *conn, uint8_t reason)
{
	printk("Disconnected (reason 0x%02x)\n", reason);

	connected_to_basestation = 0;
}

BT_CONN_CB_DEFINE(conn_callbacks) = {
	.connected = connected,
	.disconnected = disconnected,
};

static void bt_ready(void)
{
	int err;

	printk("Bluetooth initialized\n");

	err = bt_le_adv_start(BT_LE_ADV_CONN_NAME, ad, ARRAY_SIZE(ad), NULL, 0);
	if (err) {
		printk("Advertising failed to start (err %d)\n", err);
		return;
	}

	printk("Advertising successfully started\n");
}

static void auth_cancel(struct bt_conn *conn)
{
	char addr[BT_ADDR_LE_STR_LEN];

	bt_addr_le_to_str(bt_conn_get_dst(conn), addr, sizeof(addr));

	printk("Pairing cancelled: %s\n", addr);
}

static struct bt_conn_auth_cb auth_cb_display = {
	.cancel = auth_cancel,
};

/**
 * Function that initialized everything related with bluetooth
 */
static int connect_bluetooth() {
    int err = bt_enable(NULL);
	if (err) {
		printk("Bluetooth init failed (err %d)\n", err);
		return 0;
	}

	bt_ready();

	bt_conn_auth_cb_register(&auth_cb_display);

    return 1;
}

/**
 * Function that sends ambient sensor value to basestation
 */
static void send_light_sensor_value(uint16_t value) {
	printk("Sending ambient light value %d lux to basestation\n", value);
	bt_gatt_notify(NULL, &controller_service.attrs[1], &value, sizeof(value));
}

/**
 * Function that sends button value to basestation
 */
static void send_button_value(uint16_t value) {
	printk("Sending button value %d to basestation\n", value);
	bt_gatt_notify(NULL, &controller_service.attrs[3], &value, sizeof(value));
}
```

## src/bluetooth_service.h
```c
#include <bluetooth/gatt.h>

static void ccc_cfg_changed(const struct bt_gatt_attr *attr, uint16_t value)
{
	// printk("Value: %d. Not sure what to do here\n", value);
}

// https://www.guidgenerator.com/
// a34536f1-cc82-4c80-a494-d0c51b5fb11c
#define BT_CONTROLLER_SERVICE_UUID_BYTES        0xa3, 0x45, 0x36, 0xf1, 0xcc, 0x82, 0x4c, 0x80, 0xa4, 0x94, 0xd0, 0xc5, 0x1b, 0x5f, 0xb1, 0x1c
#define BT_LIGHT_CHARACTERISTIC_UUID_BYTES      0xa3, 0x45, 0x36, 0xf2, 0xcc, 0x82, 0x4c, 0x80, 0xa4, 0x94, 0xd0, 0xc5, 0x1b, 0x5f, 0xb1, 0x1c
#define BT_BUTTON_CHARACTERISTIC_UUID_BYTES     0xa3, 0x45, 0x36, 0xf3, 0xcc, 0x82, 0x4c, 0x80, 0xa4, 0x94, 0xd0, 0xc5, 0x1b, 0x5f, 0xb1, 0x1c
#define BT_ADJUSTMENT_CHARACTERISTIC_UUID_BYTES 0xa3, 0x45, 0x36, 0xf4, 0xcc, 0x82, 0x4c, 0x80, 0xa4, 0x94, 0xd0, 0xc5, 0x1b, 0x5f, 0xb1, 0x1c

#define BT_CONTROLLER_SERVICE_UUID BT_UUID_DECLARE_128(BT_CONTROLLER_SERVICE_UUID_BYTES)
#define BT_LIGHT_CHARACTERISTIC_UUID BT_UUID_DECLARE_128(BT_LIGHT_CHARACTERISTIC_UUID_BYTES)
#define BT_BUTTON_CHARACTERISTIC_UUID BT_UUID_DECLARE_128(BT_BUTTON_CHARACTERISTIC_UUID_BYTES)
#define BT_ADJUSTMENT_CHARACTERISTIC_UUID BT_UUID_DECLARE_128(BT_ADJUSTMENT_CHARACTERISTIC_UUID_BYTES)

static void handle_adjustment_request(uint8_t data);

static ssize_t write_cb(struct bt_conn *conn,
				const struct bt_gatt_attr *attr,
				const void *buf, uint16_t len, uint16_t offset,
				uint8_t flags) {

    uint8_t data = ((uint8_t *)buf)[0];

    handle_adjustment_request(data);

    return len;
}

BT_GATT_SERVICE_DEFINE(controller_service,
    BT_GATT_PRIMARY_SERVICE(BT_CONTROLLER_SERVICE_UUID),
    BT_GATT_CHARACTERISTIC(BT_LIGHT_CHARACTERISTIC_UUID, BT_GATT_CHRC_NOTIFY, BT_GATT_PERM_NONE, NULL, NULL, NULL),
    BT_GATT_CHARACTERISTIC(BT_BUTTON_CHARACTERISTIC_UUID, BT_GATT_CHRC_NOTIFY, BT_GATT_PERM_NONE, NULL, NULL, NULL),
    BT_GATT_CHARACTERISTIC(BT_ADJUSTMENT_CHARACTERISTIC_UUID, BT_GATT_CHRC_WRITE, BT_GATT_PERM_WRITE, NULL, write_cb, NULL),
    BT_GATT_CCC(ccc_cfg_changed, BT_GATT_PERM_READ | BT_GATT_PERM_WRITE)
);
```
